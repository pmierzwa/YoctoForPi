## poky/build/conf/bblayers.conf
```bitbake
# POKY_BBLAYERS_CONF_VERSION is increased each time build/conf/bblayers.conf
# changes incompatibly
POKY_BBLAYERS_CONF_VERSION = "2"

BBPATH = "${TOPDIR}"
BBFILES ?= ""

BBLAYERS ?= " \
  /home/peter/poky/meta \
  /home/peter/poky/meta-poky \
  /home/peter/poky/meta-yocto-bsp \
  /home/peter/poky/meta-openembedded/meta-oe \
  /home/peter/poky/meta-openembedded/meta-multimedia \
  /home/peter/poky/meta-openembedded/meta-networking \
  /home/peter/poky/meta-openembedded/meta-python \
  /home/peter/poky/meta-raspberrypi \
"
```

## poky/meta-pymysql/conf/layer.conf
```bitbake
# We have a conf and classes directory, add to BBPATH
BBPATH .= ":${LAYERDIR}"

# We have recipes-* directories, add to BBFILES
BBFILES += "${LAYERDIR}/recipes-*/*/*.bb \
            ${LAYERDIR}/recipes-*/*/*.bbappend"

BBFILE_COLLECTIONS += "layerpymysql"
BBFILE_PATTERN_layerpymysql = "^${LAYERDIR}/"
BBFILE_PRIORITY_layerpymysql = "5"
LAYERVERSION_layerpymysql = "4"
LAYERSERIES_COMPAT_layerpymysql = "rocko"
```

## poky/rpi-build/conf/bblayers.conf
```bitbake
# POKY_BBLAYERS_CONF_VERSION is increased each time build/conf/bblayers.conf
# changes incompatibly
POKY_BBLAYERS_CONF_VERSION = "2"

BBPATH = "${TOPDIR}"
BBFILES ?= ""

BBLAYERS ?= " \
  /home/peter/YoctoForPi/poky/meta \
  /home/peter/YoctoForPi/poky/meta-poky \
  /home/peter/YoctoForPi/poky/meta-yocto-bsp \
  /home/peter/YoctoForPi/poky/meta-openembedded/meta-oe \
  /home/peter/YoctoForPi/poky/meta-openembedded/meta-multimedia \
  /home/peter/YoctoForPi/poky/meta-openembedded/meta-networking \
  /home/peter/YoctoForPi/poky/meta-openembedded/meta-python \
  /home/peter/YoctoForPi/poky/meta-raspberrypi \
  "
```
